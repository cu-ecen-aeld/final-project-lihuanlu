## base_external/Config.in
```kconfig
source "$BR2_EXTERNAL_PROJECT_BASE_PATH/package/tmpcontrol/Config.in"
source "$BR2_EXTERNAL_PROJECT_BASE_PATH/package/device/Config.in"
```

## base_external/package/device/Config.in
```kconfig
config BR2_PACKAGE_DEVICE
	bool "device"
	help
	  This package builds and installs the push button, lcd, and sensor drivers.
```

## base_external/package/tmpcontrol/Config.in
```kconfig
config BR2_PACKAGE_TMPCONTROL
	bool "tmpcontrol"
	help
	  This package builds the user space main program - tmpcontrol.
```
